## configs/cameras-exp/tptek_wor605_t41nq_gc5603_eth+rtl8733bu/tptek_wor605_t41nq_gc5603_eth+rtl8733bu_defconfig
```kconfig
# NAME: TPTEK WOR605 (T41NQ, GC5603, ETH, RTL8733BU)
# FRAG: soc-xburst2 core
BR2_AVPU_CLK_600MHZ=y
BR2_AVPU_SCLKA=y
BR2_ETHERNET=y
BR2_INGENIC_SOC_MODEL="t41nq"
BR2_PACKAGE_THINGINO_KOPT_DWC2=y
BR2_PACKAGE_THINGINO_KOPT_DWC2_WIFI_ONLY=y
BR2_PACKAGE_THINGINO_KOPT_MMC0=y
BR2_PACKAGE_THINGINO_KOPT_MMC0_PB_4BIT=y
BR2_PACKAGE_THINGINO_UBOOT_FLASH_CONTROLLER_JZ_SFC=n
BR2_PACKAGE_THINGINO_UBOOT_FLASH_CONTROLLER_SFC0_NOR=y
BR2_PACKAGE_WIFI=y
BR2_PACKAGE_WIFI_RTL8733BU=y
BR2_SENSOR_1_NAME="gc5603"
BR2_THINGINO_AUDIO=y
BR2_THINGINO_BUTTON=y
BR2_THINGINO_MOTORS=y
BR2_THINGINO_RMEM_MB=64
BR2_THINGINO_SDCARD=y
FLASH_SIZE_MB=16
```
